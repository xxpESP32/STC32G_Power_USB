/*
*注意：使用keil需要设置为GB2312
*==============================硬件I2C源文件=======================
*-------------------------------------------------------------------
*文件修改历史
*<时间>    | <版本>  | <作者>  | <功能>  
*2023.2.24 | V1.0.2   | 小夏    | 硬件I2C配置
*-------------------------------------------------------------------
*如需要教学请到CSDN上面搜索"单片有机机"的STC32G专栏
*/

#include "I2C.h"
/*-------------------------------------------------------------
*功能：硬件I2C初始化
*作者：小夏
*修改时间：2023.2.24
*参考：<STC32G技术手册>
*-------------------------------------------------------------*/
void I2C_Init(u8 Mode){
	switch(Mode){
		case 1 :
				I2C_S1=0;
				I2C_S0=0;
		break;
		case 2 :
				I2C_S1=0;
				I2C_S0=1;
		break;
		case 3 :
				I2C_S1=1;
				I2C_S0=1;
		break;			
	}
	I2CCFG=0xe0;
	I2CMSST=0x00;
}
/*-------------------------------------------------------------
*功能：硬件I2C的等待配置
*作者：小夏
*修改时间：2023.2.24
*参考：<STC32G技术手册>
*-------------------------------------------------------------*/
static void Wait(void){
	while(!(I2CMSST & 0x40));
	I2CMSST &=~0x40;
}
/*-------------------------------------------------------------
*功能：硬件I2C的起始位配置
*作者：小夏
*修改时间：2023.2.24
*参考：<STC32G技术手册>
*-------------------------------------------------------------*/
void I2C_Start(void)
{
	I2CMSCR =0x01;
	Wait();	
}
/*-------------------------------------------------------------
*功能：硬件I2C的停止位配置
*作者：小夏
*修改时间：2023.2.24
*参考：<STC32G技术手册>
*-------------------------------------------------------------*/
void I2C_Stop(void)
{
	I2CMSCR =0x06;
	Wait();	
}
/*-------------------------------------------------------------
*功能：硬件I2C发送一个u8字节配置
*作者：小夏
*修改时间：2023.2.24
*参考：<STC32G技术手册>
*-------------------------------------------------------------*/
void I2C_Send_Byte(u8 dat)
{
	I2CTXD = dat;
	I2CMSCR = 0x02;
	Wait();
}
/*-------------------------------------------------------------
*功能：硬件I2CACK等待配置
*作者：小夏
*修改时间：2023.2.24
*参考：<STC32G技术手册>
*-------------------------------------------------------------*/
void I2C_Wait_ACK(void)
{
	I2CMSCR = 0x03;
	Wait();
}
/*-------------------------------------------------------------
*功能：硬件I2C读取一个u8字节配置
*作者：小夏
*修改时间：2023.2.24
*参考：<STC32G技术手册>
*-------------------------------------------------------------*/
u8 I2C_Read_Byte(void)
{
	I2CMSCR =0x04;
	Wait();
	return I2CRXD;
	
}
/*-------------------------------------------------------------
*功能：硬件I2CACK应答配置
*作者：小夏
*修改时间：2023.2.24
*参考：<STC32G技术手册>
*-------------------------------------------------------------*/
void I2C_ACK(void)
{
	I2CMSST =0x00;
	I2CMSCR =0x05;
	Wait();
	
}
/*-------------------------------------------------------------
*功能：硬件I2CNCK非应答配置
*作者：小夏
*修改时间：2023.2.24
*参考：<STC32G技术手册>
*-------------------------------------------------------------*/
void I2C_NACK(void)
{
	I2CMSST =0x01;
	I2CMSCR =0x05;
	Wait();
	
}
/*-------------------------------------------------------------
*功能：硬件I2C等待延时配置
*作者：小夏
*修改时间：2023.2.24
*参考：<STC32G技术手册>
*-------------------------------------------------------------*/
void I2C_Delay(void){
	
	int i;
	for(i=0;i<3000;i++)
	{
		_nop_();
		_nop_();
		_nop_();
		_nop_();
	}
	
}




















